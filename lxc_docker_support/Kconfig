## lxc_docker_support/Kconfig
```kconfig
# LXC/Docker Support Configuration for Android GKI Kernels
#
# This Kconfig provides a comprehensive set of kernel options required for
# running Docker and LXC containers on Android devices.
#
# The configuration is organized into:
# 1. Core networking and device support
# 2. Namespace and cgroup support (essential for containers)
# 3. Network filtering and NAT
# 4. Optional features (statistics, swap, storage backends)
#
# Note: The main DOCKER config uses many "select" statements to automatically
# enable all required dependencies. This is intentional to ensure users don't
# miss critical options that would prevent containers from working.
#
# Based on: https://github.com/tomxi1997/lxc-docker-support-for-android
# References:
# - Gentoo Docker Wiki: https://wiki.gentoo.org/wiki/Docker
# - Android Kernel Documentation
#
menu "LXC/Docker support for Android"

config DOCKER
	bool "Docker/LXC support"
	default n
	help
		Enable options required for Docker and LXC containers on Android.
		This includes namespaces, cgroups, and networking features.

	select PROC_PID_CPUSET
	select NET
	select NETDEVICES
	select NET_CORE
	select INET
	select IPV6
	select NET_L3_MASTER_DEV
	select NETFILTER
	select NETFILTER_ADVANCED
	select NF_CONNTRACK
	select NETFILTER_XTABLES
	select NF_CONNMARK_IPV4
	select IP_NF_IPTABLES
	select NF_NAT_MASQUERADE_IPV4
	select IP_NF_NAT
	select IP_NF_TARGET_NETMAP
	select IP_NF_TARGET_REDIRECT
	select NET_SCHED
	select CGROUP_NET_PRIO
	select CGROUP_NET_CLASSID
	select MD
	select TTY
	select UNIX98_PTYS
	select HUGETLBFS
	select PERSISTENT_KEYRINGS
	select ENCRYPTED_KEYS
	select KEY_DH_OPERATIONS

	# Namespaces and cgroups
	select NAMESPACES
	select NET_NS
	select PID_NS
	select IPC_NS
	select UTS_NS
	select CGROUPS
	select CGROUP_CPUACCT
	select CGROUP_DEVICE
	select CGROUP_FREEZER
	select CGROUP_SCHED
	select CPUSETS
	select MEMCG
	select KEYS
	select VETH
	select BRIDGE
	select BRIDGE_NETFILTER
	select NF_NAT_IPV4
	select IP_NF_FILTER
	select IP_NF_TARGET_MASQUERADE
	select NETFILTER_XT_MATCH_ADDRTYPE
	select NETFILTER_XT_MATCH_CONNTRACK
	select NF_NAT
	select NF_NAT_NEEDED
	select POSIX_MQUEUE
	select USER_NS
	select SECCOMP
	select CGROUP_PIDS
	select BLK_DEV_THROTTLING
	select CGROUP_HUGETLB
	select NET_CLS_CGROUP
	select FAIR_GROUP_SCHED
	select RT_GROUP_SCHED
	select IP_VS
	select IP_VS_PROTO_TCP
	select IP_VS_PROTO_UDP
	select IP_VS_NFCT
	select VXLAN
	select IPVLAN
	select MACVLAN
	select DUMMY
	select MEMCG_KMEM
	select NETFILTER_XT_MATCH_IPVS
	select IP_VS_RR
	select BRIDGE_VLAN_FILTERING
	select NETFILTER_XT_TARGET_CHECKSUM
	select FHANDLE
	select UNIX_DIAG
	select PACKET_DIAG
	select NETLINK_DIAG
	select CHECKPOINT_RESTORE
	select NETFILTER_XT_MATCH_CGROUP
	select BINFMT_MISC

config DOCKER_STATISTICS
	bool "Gathering statistics"
	default y if DOCKER
	depends on DOCKER
	help
		Allow gathering statistics from running containers

	select BLK_CGROUP
	select CGROUP_PERF
	select CFS_BANDWIDTH

config DOCKER_SWAP
	bool "Enable swap limit"
	default n
	depends on DOCKER
	help
		Yes if you want to be able to limit swap usage of containers

	select MEMCG_SWAP
	select MEMCG_SWAP_ENABLED

config DOCKER_SECURE_NETWORKS
	bool "Secure networks"
	default y if DOCKER
	depends on DOCKER
	help
		Yes if you use secure networks

	select XFRM_ALGO
	select XFRM_USER

config DOCKER_DEVICE_MAPPER
	bool "Device Mapper support"
	default y if DOCKER
	depends on DOCKER
	help
		Yes if you want support for device mapper (recommended)

	select BLK_DEV_DM
	select DM_THIN_PROVISIONING
	select EXT4_FS
	select EXT4_FS_POSIX_ACL
	select EXT4_FS_SECURITY

config DOCKER_OVERLAY_FS
	bool "Use overlay FS"
	default y
	depends on DOCKER
	help
		Yes if want to use the Overlay FS (recommended)

	select OVERLAY_FS
	select EXT4_FS_SECURITY
	select EXT4_FS_POSIX_ACL

endmenu
```
